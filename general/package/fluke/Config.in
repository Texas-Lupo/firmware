## general/package/fluke/Config.in
```kconfig
config BR2_PACKAGE_FLUKE
	bool "qlink"
	depends on BR2_TOOLCHAIN_HAS_THREADS
	help
	  QLink Adaptive Link Manager for UAV video transmission.
	  Monitors telemetry and dynamically adjusts WFB-ng/Majestic settings.

	  https://github.com/Texas-Lupo/fluke

comment "fluke needs a toolchain w/ threads"
	depends on !BR2_TOOLCHAIN_HAS_THREADS
```

## general/package/waybeam/Config.in
```kconfig
config BR2_PACKAGE_WAYBEAM
	bool "Waybeam"
	help
	  Streamer for sigmastar star6e and 6c
```
